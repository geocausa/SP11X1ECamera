/* E004cy compile-only source fragment. NOT installed. */
compute-cb@9 {
	compatible = "qcom,fastrpc-compute-cb";
	reg = <9>;
	iommus = <&apps_smmu 0x0c09 0x20>;
	dma-coherent;
	pd-type = <6>; /* CPZ_USERPD, downstream FastRPC ABI */
	status = "disabled";
};
