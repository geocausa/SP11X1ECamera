// SPDX-License-Identifier: BSD-3-Clause
/* Isolated SP11 OLED rear camera/VCM experiment; never a default DTB. */
/dts-v1/;

#include "hamoa.dtsi"
#include "x1-microsoft-denali.dtsi"
#include "x1-microsoft-denali-rear-autofocus-rfc.dtsi"

/ {
	model = "Microsoft Surface Pro 11th Edition (OLED, autofocus RFC)";
	compatible = "microsoft,denali-oled", "microsoft,denali",
		     "qcom,x1e80100";
};

&panel {
	compatible = "samsung,atna30dw01", "samsung,atna33xc20";
};
