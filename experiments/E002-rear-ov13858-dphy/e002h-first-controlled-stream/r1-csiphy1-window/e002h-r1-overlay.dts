/dts-v1/;
/plugin/;
/ {
	fragment@0 {
		target-path = "/soc@0/isp@acb7000";
		__overlay__ {
			reg = 			<0x0 0xacb7000 0x0 0x2000>,
			<0x0 0xacb9000 0x0 0x2000>,
			<0x0 0xacbb000 0x0 0x2000>,
			<0x0 0xacc6000 0x0 0x1000>,
			<0x0 0xacca000 0x0 0x1000>,
			<0x0 0xacb6000 0x0 0x1000>,
			<0x0 0xace4000 0x0 0x1000>,
			<0x0 0xace6000 0x0 0x2000>,
			<0x0 0xace8000 0x0 0x1000>,
			<0x0 0xacec000 0x0 0x4000>,
			<0x0 0xacf6000 0x0 0x1000>,
			<0x0 0xacf7000 0x0 0x1000>,
			<0x0 0xacf8000 0x0 0x1000>,
			<0x0 0xac62000 0x0 0x4000>,
			<0x0 0xac71000 0x0 0x4000>,
			<0x0 0xacc7000 0x0 0x2000>,
			<0x0 0xaccb000 0x0 0x2000>;
		};
	};
};
