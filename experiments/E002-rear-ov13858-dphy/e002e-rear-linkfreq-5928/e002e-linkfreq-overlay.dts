/dts-v1/;
/plugin/;

/ {
    fragment@0 {
        target-path = "/soc@0/cci@ac15000/i2c-bus@1/rear-probe@10";
        __overlay__ {
            microsoft,e002e-no-stream;

            port {
                endpoint {
                    link-frequencies = /bits/ 64 <592800000>;
                };
            };
        };
    };
};
